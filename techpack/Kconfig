## techpack/Kconfig
```kconfig
menu "Tech packages"

source "techpack/data/Kconfig"

menu "Camera packages"

config TECHPACK_CAMERA_XIAOMI_SM8150
    bool "Xiaomi SM8150 camera"
    help
      Xiaomi SM8150 camera

endmenu

endmenu
```
